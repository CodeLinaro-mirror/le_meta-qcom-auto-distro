## conf/distro/qcom-auto-distro.conf
```bitbake
require conf/distro/include/qcom-auto-base.inc

DISTRO_FEATURES:append = " \
    qti-audio-aw \
    qti-audio-ar \
    qti-bluetooth \
    qti-camera \
    qti-core \
    qti-data \
    qti-display \
    qti-graphics \
    qti-multimedia \
    qti-cv \
    qti-security \
    qti-tools \
    qti-vnw \
    qti-avb \
    ab-boot-support \
    qti-compute-platform \
    qti-rideware \
    qti-qcnode \
    qti-umd \
    qti-safety \
    qti-vmm \
"

DISTRO_FEATURES:remove = " \
    qti-adsp \
    qti-fastcv \
    qti-cdsp \
    qti-extra \
    qti-location \
    qti-wlan \
"
```

## conf/layer.conf
```bitbake
BBPATH .= ":${LAYERDIR}"

# We have recipes-* directories, add to BBFILES
BBFILES += "${LAYERDIR}/recipes-*/*/*.bb \
            ${LAYERDIR}/recipes-*/*/*.bbappend \
            ${LAYERDIR}/recipes-*/*.bbappend \
            ${LAYERDIR}/recipes-*/*.bb \
"

BB_LOGCONFIG = "${LAYERDIR}/conf/qti-log-config.json"
BBFILE_COLLECTIONS += "qcom-auto-distro"
BBFILE_PATTERN_qcom-auto-distro = "^${LAYERDIR}/"
BBFILE_PRIORITY_qcom-auto-distro = "18"
LAYERSERIES_COMPAT_qcom-auto-distro = "kirkstone scarthgap"
QTI_METAPATH_DISTRO := '${@os.path.normpath("${LAYERDIR}/")}'
```
