## conf/distro/qcom-auto-gvm-distro.conf
```bitbake
require conf/distro/include/qcom-auto-base.inc

DISTRO_NAME = "auto gvm"

DISTRO_FEATURES:append = " \
    qti-adsp \
    qti-audio \
    qti-audio-ar \
    qti-audio-awe \
    qti-camera \
    qti-cdsp \
    qti-cdsp1 \
    qti-core \
    qti-data \
    qti-display \
    qti-extra \
    qti-graphics \
    qti-multimedia \
    qti-security \
    qti-vnw \
    qti-tools \
    qti-avb \
    qti-fde \
    qti-fastcv \
    qti-fadas \
    qti-cv \
    ab-boot-support \
"

DISTRO_FEATURES:remove:gvm-omnix = "\
    qti-fde \
    qti-audio \
    qti-audio-ar \
    qti-security \
    qti-vnw \
    qti-fastcv \
    qti-avb \
"

# Video
DISTRO_FEATURES:append:gvm-omnix = " qti-codec2 qti-gstdeinterlace"

# Camera
DISTRO_FEATURES:append:gvm-omnix = " qti-qcx"

# Switch package format to rpm for GVM
PACKAGE_CLASSES = "package_rpm"

DISTRO_FEATURES_OPTED_OUT:append:gvm-omnix = " pulseaudio"
```
